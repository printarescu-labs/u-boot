## board/vd-rd/glasnost_m9260/Kconfig
```kconfig
if TARGET_GLASNOST_M9260

config SYS_BOARD
	default "glasnost_m9260"

config SYS_VENDOR
	default "vd-rd"

config SYS_CONFIG_NAME
	default "glasnost_m9260"

endif
```

## configs/glasnost_m9260_defconfig
```kconfig
CONFIG_ARM=y
CONFIG_SKIP_LOWLEVEL_INIT=y
CONFIG_ARCH_CPU_INIT=y
CONFIG_ARCH_AT91=y
CONFIG_TEXT_BASE=0x21f00000
CONFIG_SYS_MALLOC_LEN=0x210000
CONFIG_TARGET_GLASNOST_M9260=y
CONFIG_NR_DRAM_BANKS=1
CONFIG_HAS_CUSTOM_SYS_INIT_SP_ADDR=y
CONFIG_CUSTOM_SYS_INIT_SP_ADDR=0x21f00000
CONFIG_DEFAULT_DEVICE_TREE="microchip/at91sam9260-glasnost-m9260"
CONFIG_SYS_LOAD_ADDR=0x22000000
CONFIG_DEBUG_UART_BASE=0xfffff200
CONFIG_DEBUG_UART_CLOCK=99328000
CONFIG_DEBUG_UART=y
CONFIG_BOOTSTD_FULL=y
# CONFIG_CMDLINE_EDITING is not set
CONFIG_CMD_GPIO=y
CONFIG_CMD_MMC=y
CONFIG_CMD_SPI=y
CONFIG_OF_CONTROL=y
CONFIG_ENV_IS_IN_MMC=y
# CONFIG_NET is not set
CONFIG_CLK=y
CONFIG_CLK_AT91=y
CONFIG_AT91_GPIO=y
CONFIG_GENERIC_ATMEL_MCI=y
CONFIG_BOOTDEV_SPI_FLASH=y
CONFIG_SPI_FLASH_ATMEL=y
CONFIG_PINCTRL=y
CONFIG_PINCTRL_AT91=y
CONFIG_ATMEL_USART=y
CONFIG_SPI=y
CONFIG_WDT_AT91=y
```
